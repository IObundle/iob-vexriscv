## software/buildroot/iob_soc_defconfig
```kconfig
## Build options
BR2_CCACHE=y
BR2_CCACHE_DIR="$(HOME)/.buildroot-ccache-saxon_default"

## Target options
BR2_riscv=y
BR2_RISCV_32=y

## Instruction Set Extensions
BR2_riscv_custom=y
BR2_RISCV_ISA_CUSTOM_RVM=y
BR2_RISCV_ISA_CUSTOM_RVA=y
BR2_RISCV_ISA_CUSTOM_RVC=y
BR2_RISCV_ABI_ILP32=y

## GCC
BR2_GCC_VERSION_10_X=y

## System
BR2_TARGET_GENERIC_GETTY=y
BR2_TARGET_GENERIC_GETTY_PORT="console"
BR2_LINUX_KERNEL_DTS_SUPPORT=y
BR2_LINUX_KERNEL_CUSTOM_DTS_PATH="/media/data/Documentos/Tese/SoC/iob-soc-vexriscv/submodules/VEXRISCV/software/iob_soc.dts"

## OpenSBI
BR2_TARGET_OPENSBI=n

## Filesystem
BR2_TARGET_ROOTFS_CPIO=y
BR2_TARGET_ROOTFS_CPIO_GZIP=y

## Kernel (litex-rebase branch)
BR2_LINUX_KERNEL=y
BR2_LINUX_KERNEL_CUSTOM_GIT=y
BR2_LINUX_KERNEL_CUSTOM_REPO_URL="https://github.com/SpinalHDL/linux.git"
BR2_LINUX_KERNEL_CUSTOM_REPO_VERSION="dev"
BR2_LINUX_KERNEL_USE_CUSTOM_CONFIG=y
BR2_LINUX_KERNEL_CUSTOM_CONFIG_FILE="/media/data/Documentos/Tese/SoC/iob-soc-vexriscv/submodules/VEXRISCV/software/buildroot/linux.config"
BR2_LINUX_KERNEL_IMAGE=y

## Extra packages
BR2_PACKAGE_DHRYSTONE=y
BR2_PACKAGE_MICROPYTHON=y
```
